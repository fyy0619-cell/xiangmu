## Documentation/devicetree/bindings/iio/imu/invensense,mpu6050.yaml
```yaml
# SPDX-License-Identifier: (GPL-2.0-only OR BSD-2-Clause)
%YAML 1.2
---
$id: http://devicetree.org/schemas/iio/imu/invensense,mpu6050.yaml#
$schema: http://devicetree.org/meta-schemas/core.yaml#

title: Invensense MPU-6050 family 6-axis IMU

maintainers:
  - fyy0619-cell <fyy0619-cell@users.noreply.github.com>

description: |
  Invensense MPU-6050 / MPU-6500 / MPU-9250 accelerometer + gyroscope,
  connected over I2C. An optional interrupt line carries data-ready,
  FIFO-overflow and motion-detection interrupts.

properties:
  compatible:
    enum:
      - invensense,mpu6050
      - invensense,mpu6500
      - invensense,mpu9250

  reg:
    description: I2C address; 0x68 when AD0 is low, 0x69 when high.
    maxItems: 1

  interrupts:
    maxItems: 1

  vdd-supply:
    description: Digital/analog supply regulator (VDD).

  vddio-supply:
    description: I/O supply regulator (VLOGIC / VDDIO).

  mount-matrix:
    description: An optional 3x3 mounting rotation matrix.

required:
  - compatible
  - reg

additionalProperties: false

examples:
  - |
    #include <dt-bindings/interrupt-controller/irq.h>
    i2c {
        #address-cells = <1>;
        #size-cells = <0>;

        imu@68 {
            compatible = "invensense,mpu6050";
            reg = <0x68>;
            interrupt-parent = <&gpioa>;
            interrupts = <5 IRQ_TYPE_EDGE_RISING>;
            vdd-supply = <&v3v3>;
            vddio-supply = <&v3v3>;
        };
    };
...
```
